## flp-node/main/Kconfig.projbuild
```kconfig
menu "Forest Link Protocol"

    menu "LoRa SPI Pins (LilyGo T3-S3 V1.2 / SX1280)"
        config FLP_LORA_MOSI
            int "MOSI GPIO"
            default 6

        config FLP_LORA_MISO
            int "MISO GPIO"
            default 3

        config FLP_LORA_SCK
            int "SCK GPIO"
            default 5

        config FLP_LORA_CS
            int "CS GPIO"
            default 7

        config FLP_LORA_RST
            int "RST GPIO"
            default 8

        config FLP_LORA_DIO0
            int "DIO1 (IRQ) GPIO"
            default 9

        config FLP_LORA_BUSY
            int "BUSY GPIO"
            default 36
    endmenu

    config FLP_ESPNOW_CHANNEL
        int "ESP-NOW initial boot channel (relay-only nodes)"
        default 1
        range 1 13
        help
            Initial WiFi channel for relay-only nodes at boot, before
            LoRa discovery has run. Once the node receives a discovery
            broadcast from an exit node (or a relay that already knows
            the channel), it auto-switches to match. This value only
            matters for the first ~10 seconds after boot.

    config FLP_WIFI_DISABLED
        bool "Disable WiFi AP connection (relay-only node)"
        default n
        help
            When enabled, this node skips WiFi AP connection and MQTT
            initialisation. WiFi is still started in STA mode (no connect)
            for ESP-NOW. It participates in the ESP-NOW/LoRa mesh as a
            relay but never becomes an exit node.

    config FLP_WIFI_SSID
        string "WiFi SSID"
        default "ForestLink_AP"
        depends on !FLP_WIFI_DISABLED
        help
            SSID of the WiFi access point for MQTT cloud connectivity.

    config FLP_WIFI_PASSWORD
        string "WiFi Password"
        default "forestlink"
        depends on !FLP_WIFI_DISABLED
        help
            Password for the WiFi access point.

    config FLP_MQTT_BROKER_URI
        string "MQTT Broker URI"
        default "wss://mqtt.hoshinoht.dev"
        depends on !FLP_WIFI_DISABLED
        help
            URI of the MQTT broker for cloud gateway connectivity.
            Use wss:// for MQTT over WebSocket with TLS (Cloudflare Tunnel).

    config FLP_MQTT_USERNAME
        string "MQTT Username"
        default "flp-node"
        depends on !FLP_WIFI_DISABLED
        help
            Username for MQTT broker authentication.

    config FLP_MQTT_PASSWORD
        string "MQTT Password"
        default ""
        depends on !FLP_WIFI_DISABLED
        help
            Password for MQTT broker authentication.

    menu "UART Ingest API"
        config FLP_UART_TX_PIN
            int "TX GPIO"
            default 43

        config FLP_UART_RX_PIN
            int "RX GPIO"
            default 44
    endmenu

    config FLP_DEMO_AUTO
        bool "Auto demo mode (transfer every N seconds, no button needed)"
        default n

    config FLP_DEMO_AUTO_INTERVAL_S
        int "Auto demo interval (seconds)"
        default 30
        depends on FLP_DEMO_AUTO

    config FLP_DEMO_BUTTON_PIN
        int "Demo button GPIO"
        default 1
        depends on !FLP_DEMO_AUTO

    menu "SD Card (TF Slot — SPI on HSPI)"
        config FLP_SD_ENABLED
            bool "Enable SD card"
            default y

        config FLP_SD_CS
            int "CS GPIO"
            default 13
            depends on FLP_SD_ENABLED

        config FLP_SD_MOSI
            int "MOSI GPIO"
            default 11
            depends on FLP_SD_ENABLED

        config FLP_SD_SCK
            int "SCK GPIO"
            default 14
            depends on FLP_SD_ENABLED

        config FLP_SD_MISO
            int "MISO GPIO"
            default 2
            depends on FLP_SD_ENABLED
    endmenu

    config FLP_BLOCKED_PEER
        string "Blocked peer address (hex, e.g. A1B2). Empty = none"
        default ""
        help
            Hex address of a peer to ignore at the radio level.
            Direct packets (hop_count==0) from this address are silently
            dropped, forcing multi-hop routing through intermediate relays.
            Useful for lab testing of multi-hop topologies when all boards
            are physically close together.

    menu "OLED Display (SSD1306)"
        config FLP_OLED_ENABLED
            bool "Enable OLED display"
            default y

        config FLP_OLED_SDA
            int "I2C SDA GPIO"
            default 18
            depends on FLP_OLED_ENABLED

        config FLP_OLED_SCL
            int "I2C SCL GPIO"
            default 17
            depends on FLP_OLED_ENABLED

        config FLP_OLED_RST
            int "OLED RST GPIO (-1 = none)"
            default -1
            depends on FLP_OLED_ENABLED
    endmenu

    config FLP_LED_GPIO
        int "LED output GPIO (-1 = disabled)"
        default 38
        help
            GPIO pin for the controllable LED. Set to -1 to disable.
            Default 38 is the onboard user LED on LilyGo T3-S3 V1.2.

endmenu
```
